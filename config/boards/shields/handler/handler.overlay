 #include <dt-bindings/zmk/matrix_transform.h>
/ {
	chosen {
		zmk,kscan = &kscan0;
	};

	kscan0: kscan_0 {
		compatible = "zmk,kscan-gpio-direct";

		label = "KSCAN";

		input-gpios
		=	  <&gpio1  0   (GPIO_ACTIVE_LOW | GPIO_PULL_UP)>
		    , <&gpio0 11   (GPIO_ACTIVE_LOW | GPIO_PULL_UP)>
			, <&gpio1  4   (GPIO_ACTIVE_LOW | GPIO_PULL_UP)>
			, <&gpio1  6   (GPIO_ACTIVE_LOW | GPIO_PULL_UP)>
			, <&gpio1 13   (GPIO_ACTIVE_LOW | GPIO_PULL_UP)>
			, <&gpio1 11   (GPIO_ACTIVE_LOW | GPIO_PULL_UP)>
			, <&gpio0 10   (GPIO_ACTIVE_LOW | GPIO_PULL_UP)>  
			, <&gpio0  9   (GPIO_ACTIVE_LOW | GPIO_PULL_UP)>
			;
	};
};
